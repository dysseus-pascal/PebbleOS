## fw/services/activity/Kconfig
```kconfig
# SPDX-FileCopyrightText: 2026 Core Devices LLC
# SPDX-License-Identifier: Apache-2.0

config SERVICE_ACTIVITY
    bool "Activity"
    help
      Activity (step/sleep/workout) tracking service.

if SERVICE_ACTIVITY

# Boulder: Algorithmus-Wahl - die Variante nur auf obelix und qemu_emery
choice SERVICE_ACTIVITY_ALGORITHM
    prompt "Activity algorithm"
    default SERVICE_ACTIVITY_ALGORITHM_BOULDER if BOARD_OBELIX || BOARD_QEMU_EMERY
    default SERVICE_ACTIVITY_ALGORITHM_KRAEPELIN
config SERVICE_ACTIVITY_ALGORITHM_KRAEPELIN
    bool "Kraepelin (Pebble)"
config SERVICE_ACTIVITY_ALGORITHM_BOULDER
    bool "Boulder-Kraepelin"
endchoice
rsource "boulder/Kconfig"

config SERVICE_ACTIVITY_BATCH_SAMPLES
    int "Accel samples batched per algorithm update"
    default SERVICE_ACCEL_MANAGER_BATCH_SAMPLES
    help
      Number of accelerometer samples delivered to the activity algorithm
      per callback. The algorithm runs in 5s epochs (125 samples at 25Hz);
      batching a full epoch minimizes wakeups. Defaults to the accel manager
      batch size, which is sized for the accelerometer FIFO depth.

module = SERVICE_ACTIVITY
module-str = Activity
source "subsys/logging/Kconfig.template.log_level"

endif
```

## fw/services/activity/boulder/Kconfig
```kconfig
# SPDX-FileCopyrightText: 2026 dysseus-pascal
# SPDX-License-Identifier: Apache-2.0

# Boulder-Kraepelin: die eigenen Schalter der Variante. Die Wahl selbst steht in
# fw/services/activity/Kconfig.

config BOULDER_KIESELSPORT
    bool "Boulder: Kieselsport (Training auf Pebbles Workout-Dienst)"
    default y
    depends on SERVICE_ACTIVITY_ALGORITHM_BOULDER && HRM
    help
      Kieselsport als System-App mit Dienst auf KernelBG (Schritt 2). Haengt an der
      Variante, weil Velo-Training und Pulskalorien deren Schnittstellen brauchen; deshalb
      gibt es Kieselsport nur auf obelix und qemu_emery. Die anderen Boards behalten
      Pebbles Workout-App. Ohne Pulssensor gaebe es weder Zonen noch Pulskalorien.

config BOULDER_HEALTH_APP
    bool "Boulder: eigene Health-App (ohne Systemrechte, anstelle von Pebbles)"
    default y
    depends on SERVICE_ACTIVITY_ALGORITHM_BOULDER && PLATFORM_EMERY && HRM
    help
      Boulders Health-App in fw/apps/system/boulder_health/ (Schritt 3). Sie traegt Pebbles
      ID -82, die UUID und health_app_get_info und erbt so jeden Einstieg (Startmenue, Quick
      Launch, Insights, Uebergang der Shell); fw/apps/system/CMakeLists.txt laesst dafuer Pebbles
      Ordner weg (P7). Sie zeigt nur, was die Variante misst und rechnet, darum haengt sie an
      ihr; PLATFORM_EMERY, weil die Karten fuer 200x228 gebaut sind. Die anderen Boards behalten
      Pebbles App.

config BOULDER_HEALTH_ZEITEN
    bool "Boulder: Zeitstempel der Health-App (nur QEMU-Pruefbau)"
    depends on BOULDER_HEALTH_APP && QEMU
    help
      Schreibt "bh t=<ticks> <stelle>" ins Protokoll der App (Spezifikation Schritt 3, 2.6.3).
      Daraus misst ein QEMU-Skript Start, Kartenwechsel und Auffrischen (L1-L6). Nie in einem
      Bau fuer die Uhr: Jede Zeile kostet einen Syscall im gemessenen Weg.

config BOULDER_PRUEFLAUF
    bool "Boulder: QEMU-Pruefbau (Pruefnaechte im Zeitraffer)"
    depends on SERVICE_ACTIVITY_ALGORITHM_BOULDER && QEMU && SHELL
    help
      Nur fuer Testbauten von qemu_emery (Spezifikation 7.5): baut die Referenznaechte als
      Felder ein und den Shell-Befehl "boulder prueflauf <n>". Schreibt in die echte
      Sitzungsliste und ins Datalogging des QEMU-Abbilds.

config BOULDER_PRUEFLAUF_HEAP
    int "Boulder: Kernel-Heap von obelix fuer den Ballast (Byte)"
    depends on BOULDER_PRUEFLAUF
    default 72736
    help
      _heap_end - _heap_start im Release-Bau obelix@pvt (Schritt 1 AP9: 75136; Schritt 2 AP7
      mit Kieselsport: 71232; mit der Sperre des Kalorienzaehlers: 71200; Schritt 3 AP6, ohne
      Pebbles Health-App und mit S1-S7: 72736). Der Pruefbau haelt
      den Rest des QEMU-Heaps als Ballast fest (Spezifikation 7.2). Der QEMU-Heap ist zur
      Laufzeit auf 131068 B gekappt (heap_init), nicht die 147264 B zwischen den Linker-Symbolen.
```
